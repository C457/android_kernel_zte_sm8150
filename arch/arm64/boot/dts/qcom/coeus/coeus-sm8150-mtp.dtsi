/* Copyright (c) 2018, The Linux Foundation. All rights reserved.
 *
 * This program is free software; you can redistribute it and/or modify
 * it under the terms of the GNU General Public License version 2 and
 * only version 2 as published by the Free Software Foundation.
 *
 * This program is distributed in the hope that it will be useful,
 * but WITHOUT ANY WARRANTY; without even the implied warranty of
 * MERCHANTABILITY or FITNESS FOR A PARTICULAR PURPOSE.  See the
 * GNU General Public License for more details.
 */

&extcon_usb1 {
	compatible = "linux,extcon-usb-gpio";
	vbus-gpio = <&pm8150_gpios 10 GPIO_ACTIVE_HIGH>;
	/*id-gpio = <&tlmm 101 GPIO_ACTIVE_HIGH>;*/
	id-gpio = <&tlmm 127 GPIO_ACTIVE_HIGH>;
	vbus-out-gpio = <&pm8150_gpios 9 GPIO_ACTIVE_HIGH>;

	pinctrl-names = "default";
	pinctrl-0 = <&usb2_vbus_det_default
		     &usb2_id_det_default
		     &usb2_vbus_boost_default>;
};


&soc {
	zte_net_card_power_ctrl {
		compatible = "zte,netcard-power-ctrl";
		power-gpio = <&tlmm 28 GPIO_ACTIVE_HIGH>;
		pinctrl-names = "default";
		pinctrl-0 = <&net_card_power_ctrl_off>;
	};
};

