/* Copyright (c) 2017-2018, The Linux Foundation. All rights reserved.
 *
 * This program is free software; you can redistribute it and/or modify
 * it under the terms of the GNU General Public License version 2 and
 * only version 2 as published by the Free Software Foundation.
 *
 * This program is distributed in the hope that it will be useful,
 * but WITHOUT ANY WARRANTY; without even the implied warranty of
 * MERCHANTABILITY or FITNESS FOR A PARTICULAR PURPOSE.  See the
 * GNU General Public License for more details.
 */

&mdss_mdp {
	dsi_visionox_rm692a4_amoled_fhd_cmd: qcom,dsi_visionox_rm692a4_amoled_fhd_cmd_display {
		qcom,mdss-dsi-panel-name =
				"Visionox-RM692A4-1080-2340-6P5Inch";
		qcom,mdss-dsi-panel-type = "dsi_cmd_mode";
		qcom,mdss-dsi-virtual-channel-id = <0>;
		qcom,mdss-dsi-stream = <0>;
		qcom,mdss-dsi-bpp = <24>;
		qcom,mdss-dsi-underflow-color = <0xff>;
		qcom,mdss-dsi-border-color = <0>;
		qcom,mdss-dsi-traffic-mode = "burst_mode";
		qcom,mdss-dsi-te-pin-select = <1>;
		qcom,mdss-dsi-te-dcs-command = <1>;
		qcom,mdss-dsi-te-check-enable;
		qcom,mdss-dsi-te-using-te-pin;
		qcom,mdss-dsi-bllp-eof-power-mode;
		qcom,mdss-dsi-bllp-power-mode;
		qcom,mdss-dsi-lane-0-state;
		qcom,mdss-dsi-lane-1-state;
		qcom,mdss-dsi-lane-2-state;
		qcom,mdss-dsi-lane-3-state;
		qcom,mdss-dsi-lp11-init;
		qcom,mdss-dsi-reset-sequence = <1 10>, <0 10>, <1 20>;
		qcom,mdss-dsi-tx-eot-append;
		qcom,mdss-dsi-post-init-delay = <1>;
		qcom,mdss-dsi-dma-trigger = "trigger_sw";
		qcom,mdss-dsi-mdp-trigger = "none";
		qcom,mdss-dsi-bl-min-level = <270>;
		qcom,mdss-dsi-bl-max-level = <3840>;
		qcom,mdss-dsi-bl-pmic-control-type = "bl_ctrl_dcs";
		qcom,mdss-dsi-panel-hdr-enabled;
		qcom,mdss-dsi-panel-hdr-color-primaries = <14500 15500 32000
			17000 15500 30000 8000 3000>;
		qcom,mdss-dsi-panel-peak-brightness = <4200000>;
		qcom,mdss-dsi-panel-blackness-level = <3230>;
		qcom,mdss-pan-physical-width-dimension = <69>;
		qcom,mdss-pan-physical-height-dimension = <149>;

		qcom,mdss-dsi-display-timings {
			timing@0{
				qcom,mdss-dsi-panel-width = <1080>;
				qcom,mdss-dsi-panel-height = <2340>;
				qcom,mdss-dsi-h-front-porch = <60>;
				qcom,mdss-dsi-h-back-porch = <60>;
				qcom,mdss-dsi-h-pulse-width = <8>;
				qcom,mdss-dsi-h-sync-skew = <0>;
				qcom,mdss-dsi-v-back-porch = <24>;
				qcom,mdss-dsi-v-front-porch = <24>;
				qcom,mdss-dsi-v-pulse-width = <8>;
				qcom,mdss-dsi-h-sync-pulse = <0>;
				qcom,mdss-dsi-h-left-border = <0>;
				qcom,mdss-dsi-h-right-border = <0>;
				qcom,mdss-dsi-v-top-border = <0>;
				qcom,mdss-dsi-v-bottom-border = <0>;
				qcom,mdss-dsi-panel-framerate = <60>;
		qcom,mdss-dsi-on-command = [
			39 01 00 00 00 00 02 FE 40
			39 01 00 00 00 00 02 9A 01
			39 01 00 00 00 00 02 82 02
			39 01 00 00 00 00 02 FE B0
			39 01 00 00 00 00 02 03 18
			39 01 00 00 00 00 02 04 18
			39 01 00 00 00 00 02 05 18
			39 01 00 00 00 00 02 06 18

			39 01 00 00 00 00 02 FE 54
			39 01 00 00 00 00 02 85 06
			39 01 00 00 00 00 02 86 D0
			39 01 00 00 00 00 02 FE D0
			39 01 00 00 00 00 02 50 81
			39 01 00 00 00 00 02 FE 76
			39 01 00 00 00 00 02 00 3C
			39 01 00 00 00 00 02 09 83
			39 01 00 00 00 00 02 0A 00
			39 01 00 00 00 00 02 0B 01
			39 01 00 00 00 00 02 0C 51
			39 01 00 00 00 00 02 0D 76
			39 01 00 00 00 00 02 0E 0D
			39 01 00 00 00 00 02 0F 83
			39 01 00 00 00 00 02 10 00
			39 01 00 00 00 00 02 11 00
			39 01 00 00 00 00 02 12 68
			39 01 00 00 00 00 02 13 76
			39 01 00 00 00 00 02 14 0D
			39 01 00 00 00 00 02 51 FE
			39 01 00 00 00 00 02 52 D0
			39 01 00 00 00 00 02 53 49
			39 01 00 00 00 00 02 54 03
			39 01 00 00 00 00 02 55 30
			39 01 00 00 00 00 02 56 03
			39 01 00 00 00 00 02 58 FF
			39 01 00 00 00 00 02 59 01
			39 01 00 00 00 00 02 5A 01
			39 01 00 00 00 00 02 5B FE
			39 01 00 00 00 00 02 5C 20
			39 01 00 00 00 00 02 5D 5F
			39 01 00 00 00 00 02 5E 07
			39 01 00 00 00 00 02 68 FE
			39 01 00 00 00 00 02 69 D0
			39 01 00 00 00 00 02 6A 49
			39 01 00 00 00 00 02 6B 03
			39 01 00 00 00 00 02 6C 30
			39 01 00 00 00 00 02 6D 00
			39 01 00 00 00 00 02 6E FF
			39 01 00 00 00 00 02 6F 01
			39 01 00 00 00 00 02 70 01
			39 01 00 00 00 00 02 71 FE
			39 01 00 00 00 00 02 72 20
			39 01 00 00 00 00 02 73 5F
			39 01 00 00 00 00 02 74 01
			39 01 00 00 00 00 02 FE 72
			39 01 00 00 00 00 02 69 60
			39 01 00 00 00 00 02 FE 60
			39 01 00 00 00 00 02 EF FF
			39 01 00 00 00 00 02 FE 40
			39 01 00 00 00 00 02 26 80
			39 01 00 00 00 00 02 FE 00
			39 01 00 00 00 00 02 C2 08
			39 01 00 00 00 00 02 35 00
			39 01 00 00 00 00 03 51 00 00
			39 01 00 00 00 00 02 53 28
			05 01 00 00 78 00 02 11 00
			05 01 00 00 14 00 02 29 00
			39 01 00 00 14 00 0C 83 00 00 00 43 04 7E 01 17 02 0B 06
			39 01 00 00 00 00 02 FE 00];
				qcom,mdss-dsi-off-command = [
					39 01 00 00 00 00 02 FE 00
					05 01 00 00 32 00 02 38 00
					05 01 00 00 32 00 02 28 00
					05 01 00 00 20 00 02 10 00
				];
				qcom,mdss-dsi-on-command-state = "dsi_lp_mode";
				qcom,mdss-dsi-off-command-state = "dsi_lp_mode";
				qcom,mdss-dsi-lp1-command = [
					39 01 00 00 28 00 02 FE 00
					05 01 00 00 00 00 02 39 00
				];
				qcom,mdss-dsi-lp1-command-state =
					"dsi_lp_mode";
				qcom,mdss-dsi-nolp-command = [
					39 01 00 00 00 00 02 FE 00
					05 01 00 00 00 00 02 38 00
				];
				qcom,mdss-dsi-nolp-command-state =
					"dsi_lp_mode";
			};
		};
	};
};
