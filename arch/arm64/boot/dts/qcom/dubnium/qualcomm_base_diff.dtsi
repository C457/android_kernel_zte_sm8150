/*
 * this file is ued to change qualcomm dtsi which can't be changed by overlay
 * such as /delete-node/ /delete-property/ and alises
 * other changes must set in overlay dtsi files
 */
&soc{
	qcom,qbt1000 {
		/delete-property/ qcom,finger-detect-gpio;
	};
};
