## drivers/soc/qcom/zte/Kconfig
```kconfig
config MACH_ZTE
	bool "ZTE device"
	help
	  Support for ZTE products

config ZTE_BOARD_NAME
	string "config board dts folder"

menu "ZTE board selection"

config MACH_ZTE_PINE
	bool "Pine board"
	select MACH_ZTE
	help
	  Support for ZTE Axon 10 Pro (pine)

endmenu
```

## drivers/vendor/common/Kconfig
```kconfig
config VENDOR_COMMON_COMPILE
	bool "drivers/vendor/common drivers compile control"
	default n
	help
	  This enables drivers/vendor/common drivers to be compiled.

config VENDOR_SOC_QCOM_COMPILE
	bool "drivers/vendor/soc/qcom drivers compile control"
	default n
	help
	  This enables drivers/vendor/soc/qcom drivers to be compiled.

config SOC_QCOM
	bool "qcom common drivers"
	default n
	help
	  This enables support for common driver in qcom platform.

source "drivers/vendor/common/power/Kconfig"
```

## drivers/vendor/common/power/Kconfig
```kconfig
menuconfig POWER_VENDOR_COMMON
	bool "zte power policy"
	default n
	help
	  Say Y here, if supported zte power policy

config VENDOR_ZTE_MISC
	tristate "zte misc module"
	depends on POWER_VENDOR_COMMON
	default n
	help
	  Say Y here to enable the "pmic voter module" driver

config VENDOR_BATTERY_CAPACITY_LEARNING
	tristate "Battery Capacity Learning driver"
	depends on POWER_VENDOR_COMMON
	default n
	help
	  Say Y here to enable the "Battery Capacity Learning" driver

config VENDOR_CHARGE_ARBITRATE_SERVICE
	tristate "Charge Arbitrate Service Driver"
	depends on POWER_VENDOR_COMMON
	default n
	help
	  Say Y here to enable the "Charge Arbitrate Service" driver

config VENDOR_CHARGER_POLICY_SERVICE
	tristate "Charger Policy Service Driver"
	depends on POWER_VENDOR_COMMON && VENDOR_ZTE_MISC
	default n
	help
	  Say Y here to enable the "Charger Policy Service" driver

config VENDOR_CPU_RATE_CTRL
	tristate "use cpu rate ctrl charging current"
	depends on POWER_VENDOR_COMMON && VENDOR_ZTE_MISC
	default n
	help
	  Say Y here to enable the "Charger Policy Service" driver
```

## drivers/vendor/soc/qcom/Kconfig
```kconfig
source "drivers/vendor/soc/qcom/dpn/Kconfig"
source "drivers/vendor/soc/qcom/imem_info/Kconfig"
```

## drivers/vendor/soc/qcom/dpn/Kconfig
```kconfig
#
# pmlog driver
#
config VENDOR_DPN
  bool "DPN For Modem"
  default n
  help
    This program is used for notify ap pm status to modem
```

## drivers/vendor/soc/qcom/imem_info/Kconfig
```kconfig
config VENDOR_IMEM_INFO
	bool "ZTE IMEM INFO"
	default n
	help
	  Say 'y' here to include support for zte imem info.
```
